#include <input/processors.dtsi>
#include <dt-bindings/zmk/input_transform.h>
#include <zephyr/dt-bindings/input/input-event-codes.h>
#include <dt-bindings/zmk/keys.h>

#include "MDK.dtsi"

/ {
    zip_keybind_keys: zip_keybind_keys {
        compatible = "zmk,input-processor-keybind";
        #input-processor-cells = <0>;
        track_remainders;
        bindings = <&kp RIGHT>,
                   <&kp LEFT>,
                   <&kp UP>,
                   <&kp DOWN>;
        tick = <40>;
        wait-ms = <0>;
        tap-ms = <10>;
    };

    kscan0: kscan0 {
        compatible = "zmk,kscan-gpio-charlieplex";
        interrupt-gpios = <&gpio0 19 (GPIO_ACTIVE_HIGH)>;
        gpios
            = <&gpio1   1 (GPIO_ACTIVE_HIGH)>
            , <&gpio0   9 (GPIO_ACTIVE_HIGH)>
            , <&gpio0  10 (GPIO_ACTIVE_HIGH)>
            , <&gpio0  31 (GPIO_ACTIVE_HIGH)>
            , <&gpio1   3 (GPIO_ACTIVE_HIGH)>
            ;
    };
};